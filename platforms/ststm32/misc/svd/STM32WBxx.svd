# STM32WBxx_CM4 register map
File version: 1.6
CPU: CM4 r0p1, little endian, MPU, FPU, 4 interrupt priority bits
Registers are 32-bit, read-write, reset 0x0 unless marked. A register's access mark holds for its fields unless they carry their own. Offsets are from the block's base; lines under a group give offsets from that group; [hi:lo] are bit positions; {n}, {i} and the like mark numbered series; 'fields as' and 'values as' point back to an identical list; <NAME> marks a mode.

## Memory map
0x40000000 TIM2 size 0x400 — General-purpose-timers
0x40002400 LCD size 0x400 — Liquid crystal display controller
0x40002800 RTC size 0x400 — Real-time clock
0x40002C00 WWDG size 0x400 — System window watchdog
0x40003000 IWDG size 0x400 — Independent watchdog
0x40003800 SPI2 size 0x400
0x40005400 I2C1 size 0x400 — Inter-integrated circuit
0x40005C00 I2C3 size 0x400
0x40006000 CRS size 0x400 — Clock recovery system
0x40006800 USB size 0x800 — Universal serial bus full-speed device interface
0x40007C00 LPTIM1 size 0x400 — Low power timer
0x40008000 LPUART1 size 0x400
0x40009400 LPTIM2 size 0x400
0x40010030 VREFBUF size 0xD0 — Voltage reference buffer
0x40010100 SYSCFG size 0x100 — System configuration controller
0x40010200 COMP size 0x9 — Comparator instance 1
0x40012C00 TIM1 size 0x400 — Advanced-timers
0x40013000 SPI1 size 0x400 — Serial peripheral interface/Inter-IC sound
0x40013800 USART1 size 0x400 — Universal synchronous asynchronous receiver transmitter
0x40014400 TIM16 size 0x400 — General purpose timers
0x40014800 TIM17 size 0x400 — General purpose timers
0x40015400 SAI1 size 0x400 — Serial audio interface
0x40020000 DMA1 size 0x400 — Direct memory access controller
0x40020400 DMA2 size 0x400 — Direct memory access controller
0x40020800 DMAMUX1 size 0x400 — Direct memory access Multiplexer
0x40023000 CRC size 0x400 — Cyclic redundancy check calculation unit
0x40024000 TSC size 0x400 — Touch sensing controller
0x48000000 GPIOA size 0x400 — General-purpose I/Os
0x48000400 GPIOB size 0x400 — General-purpose I/Os
0x48000800 GPIOC size 0x400 — General-purpose I/Os
0x48000C00 GPIOD size 0x400
0x48001000 GPIOE size 0x400 — General-purpose I/Os
0x48001C00 GPIOH size 0x400 — General-purpose I/Os
0x50040000 ADC size 0x400 — Analog to Digital Converter instance 1
0x50060000 AES1 size 0x400 — Advanced encryption standard hardware accelerator 1
0x58000000 RCC size 0x400 — Reset and clock control
0x58000400 PWR size 0x400 — Power control
0x58000800 EXTI size 0x400 — External interrupt/event controller
0x58000C00 IPCC size 0x400
0x58001000 RNG size 0x400 — Random number generator
0x58001400 HSEM size 0x400
0x58001800 AES2 size 0x400 — Advanced encryption standard hardware accelerator 1
0x58002000 PKA size 0x2000
0x58004000 Flash size 0x90
0xA0001000 QUADSPI size 0x400 — QuadSPI interface
0xE000E008 SCB_ACTRL size 0x5 — System control block ACTLR
0xE000E010 STK size 0x11 — SysTick timer
0xE000E100 NVIC size 0x351 — Nested Vectored Interrupt Controller
0xE000ED00 SCB size 0x41 — System control block
0xE000ED88 FPU_CPACR size 0x5 — Floating point unit CPACR
0xE000ED90 MPU size 0x15 — Memory protection unit
0xE000EF00 NVIC_STIR size 0x5 — Nested vectored interrupt controller
0xE000EF34 FPU size 0xD — Floting point unit
0xE0042000 DBGMCU size 0x400 — Debug support

## Interrupts
0 WWDG — Window Watchdog interrupt
1 PVD (EXTI) — PVD through EXTI[16] (C1IMR2[20])
2 RTC_TAMP (RTC) — RTC/TAMP/CSS on LSE through EXTI line 19 interrupt
3 RTC_WKUP (RTC) — RTC wakeup interrupt through EXTI[19]
4 FLASH (Flash) — Flash global interrupt
5 RCC — RCC global interrupt
6 EXTI0 (EXTI) — EXTI line 0 interrupt through EXTI[0]
7 EXTI1 (EXTI) — EXTI line 0 interrupt through EXTI[1]
8 EXTI2 (EXTI) — EXTI line 0 interrupt through EXTI[2]
9 EXTI3 (EXTI) — EXTI line 0 interrupt through EXTI[3]
10 EXTI4 (EXTI) — EXTI line 0 interrupt through EXTI[4]
11 DMA1_Channel1 (DMA1) — DMA1 Channel1 global interrupt
12 DMA1_Channel2 (DMA1) — DMA1 Channel2 global interrupt
13 DMA1_Channel3 (DMA1) — DMA1 Channel3 interrupt
14 DMA1_Channel4 (DMA1) — DMA1 Channel4 interrupt
15 DMA1_Channel5 (DMA1) — DMA1 Channel5 interrupt
16 DMA1_Channel6 (DMA1) — DMA1 Channel6 interrupt
17 DMA1_Channel7 (DMA1) — DMA1 Channel 7 interrupt
18 ADC1 (ADC) — ADC1 global interrupt
19 USB_HP (USB) — USB high priority interrupt
20 USB_LP (USB) — USB low priority interrupt (including USB wakeup)
21 C2SEV (EXTI) — CPU2 SEV through EXTI[40]
22 COMP — COMP2 & COMP1 interrupt through AIEC[21:20]
23 EXTI5_9 (EXTI) — EXTI line [9:5] interrupt through EXTI[9:5]
24 TIM1_BRK (TIM1) — Timer 1 break interrupt
25 TIM1_UP (TIM1) — Timer 1 Update
26 TIM1_TRG_COM_TIM17 (TIM1) — TIM1 Trigger and Commutation interrupts and TIM17 global interrupt
27 TIM1_CC (TIM1) — TIM1 Capture Compare interrupt
28 TIM2 — TIM2 global interrupt
29 PKA — Private key accelerator interrupt
30 I2C1_EV (I2C1) — I2C1 event interrupt
31 I2C1_ER (I2C1) — I2C1 error interrupt
32 I2C3_EV (I2C3) — I2C3 event interrupt
33 I2C3_ER (I2C3) — I2C3 error interrupt
34 SPI1 — SPI 1 global interrupt
35 SPI2 — SPI1 global interrupt
36 USART1 — USART1 global interrupt
37 LPUART1 — LPUART1 global interrupt
38 SAI1 — SAI1 global interrupt
39 TSC — TSC global interrupt
40 EXTI10_15 (EXTI) — EXTI line [15:10] interrupt through EXTI[15:10]
41 RTC_ALARM (RTC) — RTC Alarms (A and B) interrupt through AIEC
42 CRS_IT (CRS) — CRS interrupt
43 PWR_SOTF (PWR) — PWR switching on the fly interrupt
44 IPCC_C1_RX_IT (IPCC) — IPCC CPU1 RX occupied interrupt
45 IPCC_C1_TX_IT (IPCC) — IPCC CPU1 TX free interrupt
46 HSEM — Semaphore interrupt 0 to CPU1
47 LPTIM1 — LPtimer 1 global interrupt
48 LPTIM2 — LPtimer 2 global interrupt
49 LCD — LCD global interrupt
50 QUADSPI — QSPI global interrupt
51 AES1 — AES1 global interrupt
52 AES2 — AES2 global interrupt
53 True_RNG (RNG) — True random number generator interrupt
54 FPU — Floating point unit interrupt
55 DMA2_CH1 (DMA2) — DMA2 channel 1 interrupt
56 DMA2_CH2 (DMA2) — DMA2 channel 2 interrupt
57 DMA2_CH3 (DMA2) — DMA2 channel 3 interrupt
58 DMA2_CH4 (DMA2) — DMA2 channel 4 interrupt
59 DMA2_CH5 (DMA2) — DMA2 channel 5 interrupt
60 DMA2_CH6 (DMA2) — DMA2 channel 6 interrupt
61 DMA2_CH7 (DMA2) — DMA2 channel 7 interrupt
62 DMAMUX_OVR (DMAMUX1) — DMAMUX overrun interrupt
